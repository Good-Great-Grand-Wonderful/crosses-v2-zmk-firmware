## Kconfig
```kconfig
DT_COMPAT_ZMK_BEHAVIOR_PAW32XX_RES_CYCLE := zmk,behavior-paw32xx-res-cycle

config ZMK_BEHAVIOR_PAW32XX_RES_CYCLE
	bool
	default $(dt_compat_enabled,$(DT_COMPAT_ZMK_BEHAVIOR_PAW32XX_RES_CYCLE))
	depends on PAW3222
	imply SETTINGS
```

## boards/gggw/crosses_v2/Kconfig.crosses_v2_left
```kconfig
# Copyright (c) 2026 Vincent Franco
# SPDX-License-Identifier: MIT

config BOARD_CROSSES_V2_LEFT
  select SOC_NRF52840_QIAA
  imply RETAINED_MEM
  imply RETENTION
  imply RETINTION_BOOT_MODE
```

## boards/gggw/crosses_v2/Kconfig.defconfig
```kconfig
# Copyright (c) 2026 Vincent Franco
# SPDX-License-Identifier: MIT

if BOARD_CROSSES_V2_LEFT

config BOARD
  default "crosses v2 left"

endif # BOARD_CROSSES_V2_LEFT

if BOARD_CROSSES_V2_RIGHT

config ZMK_SPLIT_ROLE_CENTRAL
  default y

config ZMK_KEYBOARD_NAME
  default "Crosses V2"

config BOARD
  default "crosses v2 right"

endif # BOARD_CROSSES_V2_RIGHT

if BOARD_CROSSES_V2_LEFT || BOARD_CROSSES_V2_RIGHT

config ZMK_SPLIT
  default y

config BT_CTLR
  default BT

config PINCTRL
  default y

if USB

config USB_NRFX
  default y

config USB_DEVICE_STACK
  default y

endif # USB

config SPI
  default y

endif # BOARD_CROSSES_V2_LEFT ||  BOARD_CROSSES_V2_RIGHT
```

## boards/gggw/crosses_v2/board.yml
```yaml
boards:
  - name: crosses_v2_left
    vendor: gggw
    socs:
      - name: nrf52840
  - name: crosses_v2_right
    vendor: gggw
    socs:
      - name: nrf52840
```

## boards/gggw/crosses_v2/crosses_v2_left_defconfig
```kconfig
# Copyright (c) 2026 Vincent Franco
# SPDX-License-Identifier: MIT

# Enable MPU
CONFIG_ARM_MPU=y
CONFIG_PINCTRL=y

# enable GPIO
CONFIG_GPIO=y

# Flash config
CONFIG_USE_DT_CODE_PARTITION=y
CONFIG_BUILD_OUTPUT_UF2=y
CONFIG_MPU_ALLOW_FLASH_WRITE=y
CONFIG_NVS=y
CONFIG_SETTINGS_NVS=y
CONFIG_FLASH=y
CONFIG_FLASH_PAGE_LAYOUT=y
CONFIG_FLASH_MAP=y

CONFIG_ZMK_BLE=y

# Enable external crystal
CONFIG_CLOCK_CONTROL_NRF_K32SRC_XTAL=y
CONFIG_CLOCK_CONTROL_NRF_K32SRC_30PPM=y

# Work-around for Windows bug with battery notifications
CONFIG_BT_GATT_ENFORCE_SUBSCRIPTION=n
CONFIG_BT_CTLR_TX_PWR_PLUS_8=y

CONFIG_BT_CTLR_PHY_2M=n

# The full two-byte consumer report space has compatibility issues with some
# operating systems, most notably macOS. Use the more basic single-byte usage
# space.
CONFIG_ZMK_HID_CONSUMER_REPORT_USAGES_BASIC=y

CONFIG_USB_DEVICE_MANUFACTURER="Good Great Grand Wonderful"
CONFIG_USB_DEVICE_PID=0xA122
CONFIG_USB_DEVICE_VID=0xA241

CONFIG_BT_DIS_PNP_PID=0xA122
CONFIG_BT_DIS_PNP_VID=0xA241
CONFIG_BT_DIS_MANUF="Good Great Grand Wonderful"
CONFIG_BT_DIS_MODEL="Crosses V2"

# Final boss config
CONFIG_SPI=y
CONFIG_INPUT=y
CONFIG_PAW3222=y
CONFIG_ZMK_POINTING=y
CONFIG_PMW3610_REPORT_INTERVAL_MIN=10

#CONFIG_BT_PERIPHERAL_PREF_MAX_INT=9
#CONFIG_BT_PERIPHERAL_PREF_LATENCY=16
#CONFIG_BT_BUF_ACL_TX_COUNT=32
#CONFIG_BT_L2CAP_TX_BUF_COUNT=32

#CONFIG_SPI_LOG_LEVEL_DBG=y
CONFIG_ZMK_INPUT_PROCESSOR_REPORT_RATE_LIMIT=y
CONFIG_ZMK_INPUT_PROCESSOR_REPORT_RATE_LIMIT_DEFAULT=2

CONFIG_ZMK_SLEEP=y

# Enable RGB battery indication
CONFIG_RGBLED_WIDGET=y
```

## boards/gggw/crosses_v2/crosses_v2_right_defconfig
```kconfig
# Copyright (c) 2026 Vincent Franco
# SPDX-License-Identifier: MIT

# Enable MPU
CONFIG_ARM_MPU=y
CONFIG_PINCTRL=y

# enable GPIO
CONFIG_GPIO=y

# Keyboard IDs
CONFIG_USB_DEVICE_PID=0x27db
CONFIG_USB_DEVICE_VID=0x16c0
CONFIG_USB_DEVICE_MANUFACTURER="Good Great Grand Wonderful"

# Flash config
CONFIG_USE_DT_CODE_PARTITION=y
CONFIG_BUILD_OUTPUT_UF2=y
CONFIG_MPU_ALLOW_FLASH_WRITE=y
CONFIG_NVS=y
CONFIG_SETTINGS_NVS=y
CONFIG_FLASH=y
CONFIG_FLASH_PAGE_LAYOUT=y
CONFIG_FLASH_MAP=y

# Enable external crystal
CONFIG_CLOCK_CONTROL_NRF_K32SRC_XTAL=y

CONFIG_ZMK_BLE=y
CONFIG_ZMK_USB=y
CONFIG_ZMK_STUDIO=y

# Work-around for Windows bug with battery notifications
CONFIG_BT_GATT_ENFORCE_SUBSCRIPTION=n
CONFIG_BT_CTLR_TX_PWR_PLUS_8=y

CONFIG_BT_CTLR_PHY_2M=n

# The full two-byte consumer report space has compatibility issues with some
# operating systems, most notably macOS. Use the more basic single-byte usage
# space.
CONFIG_ZMK_HID_CONSUMER_REPORT_USAGES_BASIC=y

# Final boss config
CONFIG_SPI=y
CONFIG_INPUT=y
CONFIG_PAW3222=y
CONFIG_ZMK_POINTING=y
CONFIG_ZMK_POINTING_SMOOTH_SCROLLING=y

CONFIG_ZMK_BLE_MOUSE_REPORT_QUEUE_SIZE=1
CONFIG_ZMK_BLE_EXPERIMENTAL_CONN=y
CONFIG_ZMK_BLE_EXPERIMENTAL_SEC=y
CONFIG_ZMK_BLE_EXPERIMENTAL_FEATURES=y
CONFIG_ZMK_BLE_PASSKEY_ENTRY=n
CONFIG_BT_CTLR_TX_PWR_PLUS_8=y
CONFIG_BT_CTLR_CONN_RSSI=y
CONFIG_BT_CTLR_TX_PWR_DYNAMIC_CONTROL=y
CONFIG_BT_CTLR_PHY_2M=y
CONFIG_BT_PERIPHERAL_PREF_MAX_INT=6
CONFIG_BT_TPS=y
CONFIG_BT_GATT_ENFORCE_SUBSCRIPTION=y

# Trackball config link: the USB CDC-ACM serial port for the config web app
# (Web Serial). It is the ONLY USB serial port - ZMK Studio runs over BLE, not
# USB, because two CDC-ACM ports starve ZMK's legacy USB stack (each grabs a
# READ + a ZLP-WRITE usb_transfer slot at enumeration). See docs/adr/0001.
CONFIG_USB_DEVICE_STACK=y
CONFIG_USB_CDC_ACM=y
CONFIG_SERIAL=y
CONFIG_UART_INTERRUPT_DRIVEN=y
CONFIG_UART_LINE_CTRL=y

CONFIG_ZMK_SLEEP=y
```

## config/west.yml
```yaml
manifest:
  defaults:
    revision: main
  remotes:
    - name: zmkfirmware
      url-base: https://github.com/zmkfirmware
    - name: badjeff
      url-base: https://github.com/badjeff
    - name: black-trooper
      url-base: https://github.com/black-trooper
    - name: gggw
      url-base: https://github.com/Good-Great-Grand-Wonderful
  projects:
    - name: zmk
      remote: zmkfirmware
      import: app/west.yml
    - name: zmk-input-processor-report-rate-limit
      remote: badjeff
      revision: main
    - name: zmk-input-processor-xyz
      remote: badjeff
      revision: main
    - name: zmk-driver-paw3222
      remote: black-trooper
      revision: main
    - name: zmk-behavior-paw32xx-res-cycle
      remote: gggw
      revision: vinnie/gatt
    - name: zmk-input-processor-pipeline-switch
      remote: gggw
      revision: vinnie/gatt
    - name: zmk-trackball-config
      remote: gggw
      revision: vinnie/gatt
  self:
    path: config
```

## dts/bindings/zmk,behavior-paw32xx-res-cycle.yaml
```yaml
# Copyright (c) 2026 Vincent Franco
# SPDX-License-Identifier: MIT
#
# Adapted from george-norton/zmk-behavior-sensor-attr-cycle, but targets the
# PAW32xx input driver's paw32xx_set_resolution() API instead of the Zephyr
# sensor attr API (which the PAW3222 driver does not implement).

description: Cycles the resolution (CPI) of a PAW32xx sensor through a list of values.

compatible: "zmk,behavior-paw32xx-res-cycle"

include: one_param.yaml

properties:
  sensor_device:
    required: true
    type: phandle
    description: The target PAW32xx device to set the resolution on.
  values:
    required: true
    type: array
    description: |
      A list of CPI values to cycle through. The PAW3222 driver accepts
      608-4826 and truncates to a multiple of 38 (its register step).
  persistent:
    type: boolean
    description: |
      If enabled the selected index is stored to flash and restored at power
      on. Requires the settings subsystem.
  save_delay:
    default: 2000
    type: int
    description: Time in milliseconds to wait before saving to flash.
  load_delay:
    default: 0
    type: int
    description: |
      A delay in milliseconds before the setting loaded from flash is sent to
      the device, in case the driver is not ready early in boot.
```
